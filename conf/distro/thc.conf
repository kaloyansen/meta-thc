## conf/distro/thc.conf
```bitbake
# distribution policy

require conf/distro/poky.conf

DISTROOVERRIDES = "poky:thc"

DISTRO = "thc"
DISTRO_NAME = "triplehelix-consulting.com"
DISTRO_VERSION = "3.4"
DISTRO_CODENAME = "zerg"
DISTRO_FEATURES:remove = "wayland"
DISTRO_FEATURES:remove = "gobject-introspection-data"
DISTRO_FEATURES:append = " cpufrequtils"

ROOT_HOME ??= "/home/root"
VOLATILE_LOG_DIR = "no"
```

## conf/distro/trinux.conf
```bitbake
require conf/distro/poky.conf

DISTRO = "trinux"
DISTROOVERRIDES = "poky:trinux"
DISTRO_NAME = "triple-helix-linux"
DISTRO_VERSION = "3.3"
DISTRO_CODENAME = "hydra"
```

## conf/distro/trix.conf
```bitbake
require conf/distro/poky.conf

DISTRO = "trix"
DISTROOVERRIDES = "poky:trix"
DISTRO_NAME = "triplehelix-consulting.com"
DISTRO_VERSION = "1.3"
DISTRO_CODENAME = "overlord"
```

## conf/layer.conf
```bitbake
# We have a conf and classes directory, add to BBPATH
BBPATH .= ":${LAYERDIR}"

# We have recipes-* directories, add to BBFILES
BBFILES += "${LAYERDIR}/recipes-*/*/*.bb \
            ${LAYERDIR}/recipes-*/*/*.bbappend"

BBFILE_COLLECTIONS += "meta-thc"
BBFILE_PATTERN_meta-thc = "^${LAYERDIR}/"
BBFILE_PRIORITY_meta-thc = "7"

LAYERDEPENDS_meta-thc = "core"
LAYERSERIES_COMPAT_meta-thc = "kirkstone"
```
